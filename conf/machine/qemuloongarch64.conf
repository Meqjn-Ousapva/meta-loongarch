## conf/machine/qemuloongarch64.conf
```bitbake
#@TYPE: Machine
#@NAME: generic loongarch64 machine
#@DESCRIPTION: Machine configuration for running a generic loongarch64

require conf/machine/include/loongarch/qemuloongarch.inc

DEFAULTTUNE = "loongarch64"

export ROOTFS_PACKAGE_ARCH = "loongarch64"
PACKAGE_EXTRA_ARCHS:tune-loongarch64 += " longarch64"
require conf/multilib.conf
MULTILIBS ?= ""

DISTRO_FEATURES_DEFAULT:remove = "seccomp"
SED_CONFIG_EFI = ''
PREFERRED_VERSION_linux-yocto = "6.5%"
GCCVERSION = "13.2%"
PREFERRED_VERSION_glibc = "2.38"
PREFERRED_VERSION_glibc-mtrace = "2.38"
PREFERRED_VERSION_glibc-scripts= "2.38"
PREFERRED_VERSION_glibc-locale = "2.38"
PREFERRED_VERSION_cross-localedef-native = "2.38"
PREFERRED_VERSION_nativesdk-glibc = "2.38"
BINUVERSION = "2.41"
GOVERSION = "1.20.12"
RUSTVERSION = "1.70.0"
#PREFERRED_VERSION_binutils = "2.41"
#PREFERRED_VERSION_binutils-crosssdk-x86_64-pokysdk-linux = "2.41"
```
